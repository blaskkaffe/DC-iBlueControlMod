## main/iblue/Kconfig.iblue
```kconfig
# iBlueControlMod and Dreamcast extras. Everything here is optional and off for other builds.
# Included from ../Kconfig.projbuild; see docs/FEATURES.md.

menu "iBlueControlMod and Dreamcast extras"

    config BLUERETRO_HW_IBLUECONTROLMOD
        bool "Target iBlueControlMod (internal Dreamcast mod) pinout"
        depends on BLUERETRO_HW2
        default n
        help
            Use the GPIO assignment of the iBlueControlMod board
            (reverse engineered from vendor firmware SEGA_DC_24V01):
            boot/pair button on GPIO16, status LED on GPIO13/GPIO14,
            port LEDs 15/4/2/12, port sense P1=36 P2=35 P3=32 P4=33,
            GPIO17 held low, power-on pin held (not pulsed),
            always "internal" adapter (no GPIO13/14 external detect).

    config BLUERETRO_IBLUE_RGB_LED
        bool "iBlueControlMod: PWM colour driver for the RGB status LED"
        depends on BLUERETRO_HW_IBLUECONTROLMOD
        default y
        help
            Drive the 4-pin common-anode RGB LED (GPIO13/14/25) with 3 PWM
            channels and show one selectable colour: solid when on,
            breathing while pairing, blinking while the button is held.
            Double-tap the button to switch colour (saved in NVS).
            Disable to get the vendor-identical LED behaviour.

    choice BLUERETRO_IBLUE_LED_DEFAULT_COLOR
        prompt "iBlueControlMod: default RGB LED colour"
        depends on BLUERETRO_IBLUE_RGB_LED
        default BLUERETRO_IBLUE_LED_ORANGE

        config BLUERETRO_IBLUE_LED_ORANGE
            bool "Orange (like the original Dreamcast LED)"

        config BLUERETRO_IBLUE_LED_BLUE
            bool "Blue"
    endchoice

    config BLUERETRO_IBLUE_LED_R_GPIO
        int "iBlueControlMod: RGB LED red GPIO"
        depends on BLUERETRO_IBLUE_RGB_LED
        default 25

    config BLUERETRO_IBLUE_LED_G_GPIO
        int "iBlueControlMod: RGB LED green GPIO"
        depends on BLUERETRO_IBLUE_RGB_LED
        default 14

    config BLUERETRO_IBLUE_LED_B_GPIO
        int "iBlueControlMod: RGB LED blue GPIO"
        depends on BLUERETRO_IBLUE_RGB_LED
        default 13

    config BLUERETRO_IBLUE_PAIR_WINDOW_S
        int "iBlueControlMod: pairing window in seconds (0 = unlimited)"
        depends on BLUERETRO_HW_IBLUECONTROLMOD
        default 60
        help
            Pairing (BT inquiry, blinking LEDs) is only allowed for this long
            after the console turns on, or after a button tap. Already paired
            controllers can still reconnect at any time.

    config BLUERETRO_IBLUE_LED_MAX_PCT
        int "iBlueControlMod: maximum brightness of the LEDs (percent of the PWM duty)"
        depends on BLUERETRO_IBLUE_RGB_LED
        range 10 100
        default 80
        help
            The RGB power LED and the four controller port LEDs never get brighter than this.

    config BLUERETRO_IBLUE_BOOT_ANIM
        bool "iBlueControlMod: controller port LEDs animate while the Dreamcast boot animation plays"
        depends on BLUERETRO_IBLUE_RGB_LED
        default y
        help
            When the console powers on, the four port LEDs show drops falling on water for the
            length of the BIOS boot animation (ripples run along the LEDs and bounce off the ends),
            then show the real state (a lit LED per connected controller). Port LEDs never blink
            unless a Bluetooth controller is connected.

    config BLUERETRO_IBLUE_BOOT_INTRO
        bool "iBlueControlMod: before the drops: A, B, C, D light up in turn (0.3 s each) and fade out"
        depends on BLUERETRO_IBLUE_BOOT_ANIM
        default y
        help
            Port A's pin lights by itself while the chip starts. The intro carries on from it: A is lit for
            0.3 s and fades out quickly; B lights up when A's 0.3 s are over, is lit for 0.3 s and fades, then C,
            then D. About 1.4 s, taken from the animation's time.

    config BLUERETRO_IBLUE_BOOT_ANIM_BOOT_MS
        int "iBlueControlMod: time from console power-on until this firmware runs (ms)"
        depends on BLUERETRO_IBLUE_BOOT_ANIM
        range 0 5000
        default 700
        help
            The adapter boots while the console already starts: this much of the animation is
            counted as played when the firmware starts it (bootloader time; the rest is the
            time since the firmware started).

    config BLUERETRO_IBLUE_GAMEID
        bool "iBlueControlMod: Dreamcast game id from openMenu (reserved VMU block 200)"
        depends on BLUERETRO_SYSTEM_DC && BLUERETRO_HW_IBLUECONTROLMOD
        default y
        help
            openMenu writes the product number of the game it starts into one block of the emulated
            VMU (never stored as VMU data). It becomes BlueRetro's game id, so blueretro.io can save
            a configuration per game. Needs the VMU accessory on. See docs/led-and-gameid.md.

    config BLUERETRO_IBLUE_DCAPI
        bool "iBlueControlMod: DC API (language dc1) over Maple command 0x22 and BLE command 0x51"
        depends on BLUERETRO_IBLUE_GAMEID
        default y
        help
            The adapter answers the DC API, the control language shared by the DC- projects: who it
            is, what it can do, the game id and the network openMenu or the Pi tells it. Over Maple
            (command 0x22 to the memory card unit, capability bits behind the marker in the extended
            device info) and over BLE (command 0x51). See docs/dcapi.md.

    config BLUERETRO_IBLUE_MOTION
        bool "iBlueControlMod: Joy-Con motion as maracas position and shake"
        depends on BLUERETRO_SYSTEM_DC && BLUERETRO_HW_IBLUECONTROLMOD && BLUERETRO_IBLUE_RGB_LED
        default y
        help
            Reads the accelerometer and the gyro of Joy-Cons (switched on from the web page) and turns the
            pointing direction into the right stick X / Y of the controller and a shake into the left
            trigger button, for Samba de Amigo (docs/samba-de-amigo.md). Calibrated with poses.

    config BLUERETRO_IBLUE_VMU_CHECK
        bool "iBlueControlMod: careful memory card (VMU): format a blank card, check writes, answer the beeper"
        depends on BLUERETRO_SYSTEM_DC && BLUERETRO_HW_IBLUECONTROLMOD
        default y
        help
            A blank memory card is formatted at start-up (programs made with KallistiOS, such as openMenu,
            cannot format one). A write is stored only when the frame arrived intact, otherwise the Dreamcast
            is asked to send it again. Commands for the VMU's beeper are acknowledged. A changed card is
            written to the flash even when the notice from the Maple interrupt was lost. docs/vmu.md.

    config BLUERETRO_IBLUE_DC_MENU_COLORS
        bool "iBlueControlMod: PS4/PS5 light bar colours A orange, B green, C blue, D magenta"
        depends on BLUERETRO_HW_IBLUECONTROLMOD
        default y

endmenu
```
